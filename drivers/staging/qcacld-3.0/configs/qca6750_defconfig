## drivers/staging/qcacld-3.0/configs/qca6750_defconfig
```kconfig
CONFIG_CNSS_QCA6750 := y
DEVNAME := qca6750
$(warning "### DBG CONFIG_CNSS_QCA6750")
include $(WLAN_ROOT)/configs/default_defconfig
```
